## config/west.yml
```yaml
manifest:
  defaults:
    revision: v0.3

  remotes:
    - name: zmkfirmware
      url-base: https://github.com/zmkfirmware
    - name: w0zny
      url-base: https://github.com/w0zny

  projects:
    - name: zmk
      remote: zmkfirmware
      import: app/west.yml
    - name: zmk-nice-oled
      remote: w0zny
      revision: main

  self:
    path: config
```
